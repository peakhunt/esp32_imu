## main/Kconfig.projbuild
```kconfig
menu "ESP32 IMU Configuration"

config BLINK_GPIO
    int "Blink GPIO number"
	range 0 34
	default 5
	help
		GPIO number (IOxx) to blink on and off.

		Some GPIOs are used for other purposes (flash connections, etc.) and cannot be used to blink.

		GPIOs 35-39 are input-only so cannot be used as outputs.


config WIFI_SSID
    string "WiFi SSID"
  default "myssid"
  help
    SSID (network name) for the example to connect to.

config WIFI_PASSWORD
    string "WiFi Password"
  default "myssid"
  help
    WiFi password (WPA or WPA2) for the example to use.

    Can be left blank if the network has no security set.

config TELNET_PORT
    int "Telnet Server Port number"
	default 7000
	help
		Telnet Server Port Number for CLI access.

endmenu
```
